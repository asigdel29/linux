## fs/modelfs/Kconfig
```kconfig
config MODELFS
    bool "Model filesystem"
    help
      Pseudo filesystem for signed AI model storage.
```

## kernel/ai/Kconfig
```kconfig
config AI_CORE
    bool "AINUX AI core"
    help
      Basic AI model management support.
```
